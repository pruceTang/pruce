/* Copyright (c) 2013-2016, The Linux Foundation. All rights reserved.
 *
 * This program is free software; you can redistribute it and/or modify
 * it under the terms of the GNU General Public License version 2 and
 * only version 2 as published by the Free Software Foundation.
 *
 * This program is distributed in the hope that it will be useful,
 * but WITHOUT ANY WARRANTY; without even the implied warranty of
 * MERCHANTABILITY or FITNESS FOR A PARTICULAR PURPOSE.  See the
 * GNU General Public License for more details.
 */


/ {

	aliases {
		sdhc1 = &sdhc_1; /* SDC1 eMMC slot */
		sdhc2 = &sdhc_2; /* SDC2 SD card slot */

		/* smdtty devices */
		smd1 = &smdtty_apps_fm;
		smd2 = &smdtty_apps_riva_bt_acl;
		smd3 = &smdtty_apps_riva_bt_cmd;
		smd4 = &smdtty_mbalbridge;
		smd5 = &smdtty_apps_riva_ant_cmd;
		smd6 = &smdtty_apps_riva_ant_data;
		smd7 = &smdtty_data1;
		smd8 = &smdtty_data4;
		smd11 = &smdtty_data11;
		smd21 = &smdtty_data21;
		smd36 = &smdtty_loopback;
                spi0 = &spi_0; /* SPI0 controller device */
		i2c2 = &i2c_2; /* I2C2 controller device */

	};

	spi_0: spi@78b5000 { /* BLSP1 QUP1 */
        compatible = "qcom,spi-qup-v2";
        #address-cells = <1>;
        #size-cells = <0>;
        reg-names = "spi_physical", "spi_bam_physical";
        reg = <0x78b5000 0x600>,
        <0x7884000 0x23000>;
        interrupt-names = "spi_irq", "spi_bam_irq";
        interrupts = <0 95 0>, <0 238 0>;
        spi-max-frequency = <19200000>;
        clocks = <&clock_gcc clk_gcc_blsp1_ahb_clk>,
                <&clock_gcc clk_gcc_blsp1_qup1_spi_apps_clk>;
        clock-names = "iface_clk", "core_clk";
        qcom,infinite-mode = <0>;
        qcom,use-bam;
        qcom,ver-reg-exists;
        qcom,bam-consumer-pipe-index = <4>;
        qcom,bam-producer-pipe-index = <5>;
        qcom,master-id = <86>;
        qcom,shared;
        status = "okay";
        /*qcom,use-pinctrl;
        pinctrl-names = "spi_default", "spi_sleep";
        pinctrl-0 = <&spi0_default &spi0_cs0_active>;
        pinctrl-1 = <&spi0_sleep &spi0_cs0_sleep>;*/

        spidev,spidev@0 {
            compatible = "qcom,spidev";
            reg = <0>;
            spi-max-frequency = <1000000>;
            spi-cpol = <0>;
            spi-cpha = <0>;
        };

        silead_fp@0x01 {
          compatible = "sil,silead_fp";
          qcom,qup-id = <1>;
          spi-max-frequency = <8000000>;
          reg = <1>;

          interrupt-parent = <&msm_gpio>;
          interrupts = <60 0x2008>;
          /*avdd-supply =<&avdd_power>;
	  avdd-gpios= <&msm_gpio # 0x2008>;
	  vddio-gpios= <&msm_gpio # 0x2008>;*/
          clocks = <&clock_gcc clk_gcc_blsp1_ahb_clk>,
                   <&clock_gcc clk_gcc_blsp1_qup1_spi_apps_clk>;
          clock-names = "iface_clk", "core_clk";
          pinctrl-names = "pmx_silfp_active","pmx_silfp_suspend","pmx_silfp_release","spi_default", "spi_sleep";
          pinctrl-0 = <&silfp_int_active &silfp_reset_active>;
          pinctrl-1 = <&silfp_int_suspend &silfp_reset_suspend>;
          pinctrl-2 = <&silfp_release>;
          pinctrl-3 = <&spi0_default &spi0_cs0_active>;
          pinctrl-4 = <&spi0_sleep &spi0_cs0_sleep>;
          rst-gpios = <&msm_gpio 54 0x0>;
          irq-gpios = <&msm_gpio 60 0x2008>;
      };
  };
